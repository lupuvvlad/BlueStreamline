//Last updated: 2015.09.16;
/***********************************************************************************/
/*
//For ATTINY88;
#define ADC_RESULT ADCW//Read the AD conversion result
#define ADC_CHANNEL_SELECT(adc_channel) M1(ADMUX,adc_channel)
#define ADC_CHANNEL_CLEAR M0(ADMUX,0b0000111)
//Choose the ADC Refference type;
#define ADC_REFERENCE_INTERNAL_1V1 B0(ADMUX,REFS0)
#define ADC_REFERENCE_AVCC B1(ADMUX,REFS0)
//ENABLE/DISALBE the ADC;
#define ADC_ENABLE B1(ADCSRA,ADEN)
#define ADC_DESABLE B0(ADCSRA,ADEN)
//START/STOP the ADC conversion;
#define ADC_START_CONVERTION B1(ADCSRA,ADSC)
#define ADC_STOP_CONVERTION B0(ADCSRA,ADSC)
//ENABLE/DISABLE ADC Auto Trigger;
#define ADC_AUTOTRIGGER_ENABLE B1(ADCSRA,ADATE)
#define ADC_AUTOTRIGGER_DISABLE B0(ADCSRA,ADATE)
//SELECT Autotrigger mode:
#define ADC_AUTOTRIGGER_ON_FREERUNING B0(ADCSRB,ADTS2);B0(ADCSRB,ADTS1);B0(ADCSRB,ADTS0)
#define ADC_AUTOTRIGGER_ON_ANALOG_COMP B0(ADCSRB,ADTS2);B0(ADCSRB,ADTS1);B1(ADCSRB,ADTS0)
#define ADC_AUTOTRIGGER_ON_EXTERNAL_INT B0(ADCSRB,ADTS2);B1(ADCSRB,ADTS1);B0(ADCSRB,ADTS0)
#define ADC_AUTOTRIGGER_ON_TIMER0_OCA B0(ADCSRB,ADTS2);B1(ADCSRB,ADTS1);B1(ADCSRB,ADTS0)
#define ADC_AUTOTRIGGER_ON_TIMER0_OVERFLOW B1(ADCSRB,ADTS2);B0(ADCSRB,ADTS1);B0(ADCSRB,ADTS0)
#define ADC_AUTOTRIGGER_ON_TIMER1_OCB B1(ADCSRB,ADTS2);B0(ADCSRB,ADTS1);B1(ADCSRB,ADTS0)
#define ADC_AUTOTRIGGER_ON_TIMER1_OVERFLOW B1(ADCSRB,ADTS2);B1(ADCSRB,ADTS1);B0(ADCSRB,ADTS0)
#define ADC_AUTOTRIGGER_ON_TIMER1_CAPTURE_EVENT B1(ADCSRB,ADTS2);B1(ADCSRB,ADTS1);B1(ADCSRB,ADTS0)
//ENABLE/DISABLE the ADC_INTERRUP;
#define ADC_INTERRUPT_ENABLE B1(ADCSRA,ADIE)
#define ADC_INTERRUPT_DESABLE B0(ADCSRA,ADIE)
//ENABLE/DISABLE the ADC_InterruptFlag;
#define ADC_CONVERSION_READY GET_BIT(ADCSRA,ADIF)
#define ADC_CONVERSION_READY_CLEAR_FLAG B1(ADCSRA,ADIF)
//Set the ADC_CLK from the prescaller;
#define ADC_PRESCALER_2 B0(ADCSRA,ADPS2); B0(ADCSRA,ADPS1); B1(ADCSRA,ADPS0)
#define ADC_PRESCALER_4 B0(ADCSRA,ADPS2); B1(ADCSRA,ADPS1); B0(ADCSRA,ADPS0)
#define ADC_PRESCALER_8 B0(ADCSRA,ADPS2); B1(ADCSRA,ADPS1); B1(ADCSRA,ADPS0)
#define ADC_PRESCALER_16 B1(ADCSRA,ADPS2); B0(ADCSRA,ADPS1); B0(ADCSRA,ADPS0)
#define ADC_PRESCALER_32 B1(ADCSRA,ADPS2); B0(ADCSRA,ADPS1); B1(ADCSRA,ADPS0)
#define ADC_PRESCALER_64 B1(ADCSRA,ADPS2); B1(ADCSRA,ADPS1); B0(ADCSRA,ADPS0)
#define ADC_PRESCALER_128 B1(ADCSRA,ADPS2); B1(ADCSRA,ADPS1); B1(ADCSRA,ADPS0)
*/


/*

//For ATMEGA16A;
#define ADC_RESULT (ADCW)//Read the AD conversion result
#define ADC_CHANNEL_SELECT(adc_channel) M1(ADMUX,adc_channel)
#define ADC_CHANNEL_CLEAR ADMUX&=0b11100000
//Choose the ADC Refference type;
#define ADC_REFERENCE_INTERNAL_2V56 B1(ADMUX,REFS0); B1(ADMUX,REFS1) 
#define ADC_REFERENCE_AVCC			B1(ADMUX,REFS0); B0(ADMUX,REFS1)
#define ADC_REFERENCE_AREF			B0(ADMUX,REFS0); B0(ADMUX,REFS1)
#define ADC_REFERENCE_REZERVED		B0(ADMUX,REFS0); B1(ADMUX,REFS1)
//ENABLE/DISALBE the ADC;
#define ADC_ENABLE B1(ADCSRA,ADEN)
#define ADC_DESABLE B0(ADCSRA,ADEN)
//START/STOP the ADC conversion;
#define ADC_START_CONVERTION B1(ADCSRA,ADSC)
#define ADC_STOP_CONVERTION B0(ADCSRA,ADSC)
//ENABLE/DISABLE ADC Auto Trigger;
#define ADC_AUTOTRIGGER_ENABLE B1(ADCSRA,ADATE)
#define ADC_AUTOTRIGGER_DISABLE B0(ADCSRA,ADATE)
//SELECT Autotrigger mode:
#define ADC_AUTOTRIGGER_ON_FREERUNING			B0(SFIOR,ADTS2);B0(SFIOR,ADTS1);B0(SFIOR,ADTS0)
#define ADC_AUTOTRIGGER_ON_ANALOG_COMP			B0(SFIOR,ADTS2);B0(SFIOR,ADTS1);B1(SFIOR,ADTS0)
#define ADC_AUTOTRIGGER_ON_EXTERNAL_INT			B0(SFIOR,ADTS2);B1(SFIOR,ADTS1);B0(SFIOR,ADTS0)
#define ADC_AUTOTRIGGER_ON_TIMER0_OCA			B0(SFIOR,ADTS2);B1(SFIOR,ADTS1);B1(SFIOR,ADTS0)
#define ADC_AUTOTRIGGER_ON_TIMER0_OVERFLOW		B1(SFIOR,ADTS2);B0(SFIOR,ADTS1);B0(SFIOR,ADTS0)
#define ADC_AUTOTRIGGER_ON_TIMER1_OCB			B1(SFIOR,ADTS2);B0(SFIOR,ADTS1);B1(SFIOR,ADTS0)
#define ADC_AUTOTRIGGER_ON_TIMER1_OVERFLOW		B1(SFIOR,ADTS2);B1(SFIOR,ADTS1);B0(SFIOR,ADTS0)
#define ADC_AUTOTRIGGER_ON_TIMER1_CAPTURE_EVENT B1(SFIOR,ADTS2);B1(SFIOR,ADTS1);B1(SFIOR,ADTS0)
//ENABLE/DISABLE the ADC_INTERRUP;
#define ADC_INTERRUPT_ENABLE B1(ADCSRA,ADIE)
#define ADC_INTERRUPT_DESABLE B0(ADCSRA,ADIE)
//ENABLE/DISABLE the ADC_InterruptFlag;
#define ADC_CONVERSION_READY GET_BIT(ADCSRA,ADIF)
#define ADC_CONVERSION_READY_CLEAR_FLAG B1(ADCSRA,ADIF)
//Set the ADC_CLK from the prescaller;
#define ADC_PRESCALER_2		B0(ADCSRA,ADPS2); B0(ADCSRA,ADPS1); B1(ADCSRA,ADPS0)
#define ADC_PRESCALER_4		B0(ADCSRA,ADPS2); B1(ADCSRA,ADPS1); B0(ADCSRA,ADPS0)
#define ADC_PRESCALER_8		B0(ADCSRA,ADPS2); B1(ADCSRA,ADPS1); B1(ADCSRA,ADPS0)
#define ADC_PRESCALER_16	B1(ADCSRA,ADPS2); B0(ADCSRA,ADPS1); B0(ADCSRA,ADPS0)
#define ADC_PRESCALER_32	B1(ADCSRA,ADPS2); B0(ADCSRA,ADPS1); B1(ADCSRA,ADPS0)
#define ADC_PRESCALER_64	B1(ADCSRA,ADPS2); B1(ADCSRA,ADPS1); B0(ADCSRA,ADPS0)
#define ADC_PRESCALER_128	B1(ADCSRA,ADPS2); B1(ADCSRA,ADPS1); B1(ADCSRA,ADPS0)





//===============================================================//
unsigned int Read_ADC(uint8_t adcChannel){
	ADC_CHANNEL_CLEAR;
	ADC_CHANNEL_SELECT(adcChannel);
	ADC_CONVERSION_READY_CLEAR_FLAG;
	ADC_START_CONVERTION;
	while(!ADC_CONVERSION_READY){}
	return ADC_RESULT;
}
unsigned int Read_DIF_ADC23(){
	ADC_CHANNEL_CLEAR;
	ADMUX|=0b00001111;
	_delay_ms(5);
	//ADC_START_CONVERTION;
// 	while(!ADC_CONVERSION_READY){}
// 	ADC_CONVERSION_READY_CLEAR_FLAG;	
	ADC_START_CONVERTION;
	while(!ADC_CONVERSION_READY){}
	ADC_CONVERSION_READY_CLEAR_FLAG;
	return ADC_RESULT;
}
unsigned int Read_DIF_ADC10(){
	ADC_CHANNEL_CLEAR;
	ADMUX|=0b00010000;
// 	ADC_START_CONVERTION;
// 	while(!ADC_CONVERSION_READY){}
// 	ADC_CONVERSION_READY_CLEAR_FLAG;	
_delay_ms(5);
	ADC_START_CONVERTION;
	while(!ADC_CONVERSION_READY){}
	ADC_CONVERSION_READY_CLEAR_FLAG;
	return ADC_RESULT;
}


// int  (uint8_t adcChannel){
// 	#define readTimes 25
// 	int arr[readTimes]={};
// 	uint8_t t=0;//Temporar variable;
// 	uint8_t i=0;//Current item from the Array;
// 	uint8_t j=1;//Current verified Item from the Array;
// 	uint8_t k=0;//Temporar variable;
// 	uint8_t repeat=readTimes;
// 	while(repeat--){
// 		arr[repeat]=Read_ADC(adcChannel);
// 	}
// 	repeat=readTimes-1;
// 	//Sort the Array ascendant;
// 	while(repeat--){
// 		i=0;
// 		while(i<j){
// 			if(arr[j]<arr[i]){
// 				k=j;
// 				t=arr[j];
// 				while(k>i){
// 					arr[k]=arr[k-1];
// 					k--;
// 				}
// 				arr[i]=t;
// 			}
// 			else{i++;}
// 		}
// 		j++;
// 	}
// 	return arr[(readTimes-1)/2];//Return the middle value;
// }


void ADCInit(void){
	ADC_REFERENCE_AVCC;//497
	ADC_ENABLE;
	ADC_PRESCALER_32;
}
*/




//For AT90CAN;
#define ADC_RESULT (ADCW)//Read the AD conversion result
#define ADC_CHANNEL_SELECT(adc_channel) M1(ADMUX,adc_channel)
#define ADC_CHANNEL_CLEAR ADMUX&=0b11100000
//Choose the ADC Refference type;
#define ADC_REFERENCE_INTERNAL_2V56 	B1(ADMUX,REFS0); B1(ADMUX,REFS1) //with external capacitor on REF pin
#define ADC_REFERENCE_AVCC						B1(ADMUX,REFS0); B0(ADMUX,REFS1) //with external capacitor on REF pin
#define ADC_REFERENCE_AREF						B0(ADMUX,REFS0); B0(ADMUX,REFS1) //Vref turned OFF
#define ADC_REFERENCE_REZERVED				B0(ADMUX,REFS0); B1(ADMUX,REFS1)
//ANALOG CHANNEL SELECTION BITS
//------------------------

//ENABLE/DISALBE the ADC
#define ADC_ENABLE B1(ADCSRA,ADEN)
#define ADC_DESABLE B0(ADCSRA,ADEN)
//START/STOP the ADC conversion;
#define ADC_START_CONVERTION B1(ADCSRA,ADSC)
#define ADC_STOP_CONVERTION B0(ADCSRA,ADSC)
//ENABLE/DISABLE ADC Auto Trigger;
#define ADC_AUTOTRIGGER_ENABLE B1(ADCSRA,ADATE)
#define ADC_AUTOTRIGGER_DISABLE B0(ADCSRA,ADATE)
//SELECT Autotrigger mode:
#define ADC_AUTOTRIGGER_ON_FREERUNING						B0(ADCSRB,ADTS2);B0(ADCSRB,ADTS1);B0(ADCSRB,ADTS0)
#define ADC_AUTOTRIGGER_ON_ANALOG_COMP						B0(ADCSRB,ADTS2);B0(ADCSRB,ADTS1);B1(ADCSRB,ADTS0)
#define ADC_AUTOTRIGGER_ON_EXTERNAL_INT						B0(ADCSRB,ADTS2);B1(ADCSRB,ADTS1);B0(ADCSRB,ADTS0)
#define ADC_AUTOTRIGGER_ON_TIMER0_OCA						B0(ADCSRB,ADTS2);B1(ADCSRB,ADTS1);B1(ADCSRB,ADTS0)
#define ADC_AUTOTRIGGER_ON_TIMER0_OVERFLOW					B1(ADCSRB,ADTS2);B0(ADCSRB,ADTS1);B0(ADCSRB,ADTS0)
#define ADC_AUTOTRIGGER_ON_TIMER1_OCB						B1(ADCSRB,ADTS2);B0(ADCSRB,ADTS1);B1(ADCSRB,ADTS0)
#define ADC_AUTOTRIGGER_ON_TIMER1_OVERFLOW					B1(ADCSRB,ADTS2);B1(ADCSRB,ADTS1);B0(ADCSRB,ADTS0)
#define ADC_AUTOTRIGGER_ON_TIMER1_CAPTURE_EVENT 			B1(ADCSRB,ADTS2);B1(ADCSRB,ADTS1);B1(ADCSRB,ADTS0)
//ENABLE/DISABLE the ADC_INTERRUP;
#define ADC_INTERRUPT_ENABLE B1(ADCSRA,ADIE)
#define ADC_INTERRUPT_DESABLE B0(ADCSRA,ADIE)
//ENABLE/DISABLE the ADC_InterruptFlag;
#define ADC_CONVERSION_READY GET_BIT(ADCSRA,ADIF)
#define ADC_CONVERSION_READY_CLEAR_FLAG B1(ADCSRA,ADIF)
//Set the ADC_CLK from the prescaller;
#define ADC_PRESCALER_2		B0(ADCSRA,ADPS2); B0(ADCSRA,ADPS1); B1(ADCSRA,ADPS0)
#define ADC_PRESCALER_4		B0(ADCSRA,ADPS2); B1(ADCSRA,ADPS1); B0(ADCSRA,ADPS0)
#define ADC_PRESCALER_8		B0(ADCSRA,ADPS2); B1(ADCSRA,ADPS1); B1(ADCSRA,ADPS0)
#define ADC_PRESCALER_16	B1(ADCSRA,ADPS2); B0(ADCSRA,ADPS1); B0(ADCSRA,ADPS0)
#define ADC_PRESCALER_32	B1(ADCSRA,ADPS2); B0(ADCSRA,ADPS1); B1(ADCSRA,ADPS0)
#define ADC_PRESCALER_64	B1(ADCSRA,ADPS2); B1(ADCSRA,ADPS1); B0(ADCSRA,ADPS0)
#define ADC_PRESCALER_128	B1(ADCSRA,ADPS2); B1(ADCSRA,ADPS1); B1(ADCSRA,ADPS0)





/**************************************************************************************/
unsigned int Read_ADC(uint8_t adcChannel){
	ADC_CHANNEL_CLEAR;
	ADC_CHANNEL_SELECT(adcChannel);
	ADC_CONVERSION_READY_CLEAR_FLAG;
	ADC_START_CONVERTION;
	while(!ADC_CONVERSION_READY){}
	return ADC_RESULT;
}
unsigned int Read_DIF_ADC23(){
	ADC_CHANNEL_CLEAR;
	ADMUX|=0b00001111;
	_delay_ms(5);	
	ADC_START_CONVERTION;
	while(!ADC_CONVERSION_READY){}
	ADC_CONVERSION_READY_CLEAR_FLAG;
	return ADC_RESULT;
}
unsigned int Read_DIF_ADC10(){
	ADC_CHANNEL_CLEAR;
	ADMUX|=0b00010000;	
_delay_ms(5);
	ADC_START_CONVERTION;
	while(!ADC_CONVERSION_READY){}
	ADC_CONVERSION_READY_CLEAR_FLAG;
	return ADC_RESULT;
}



void ADCInit(void){
	ADC_REFERENCE_INTERNAL_2V56;//497
	ADC_ENABLE;
	ADC_PRESCALER_32;
}